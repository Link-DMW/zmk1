/*
* Copyright (c) 2021 Polarity Works
*
* SPDX-License-Identifier: MIT
*/

/dts-v1/;
#include "bt60.dtsi"
//#include <layouts/common/60percent/ansi.dtsi>

/ {
    chosen {
        zmk,kscan = &kscan0;
        //zmk,physical-layout = &layout_60_ansi;
    };

    default_transform: keymap_transform_0 {
        compatible = "zmk,matrix-transform";
        columns = <15>;
        rows = <5>;
        map = <
            RC(0,0) RC(0,1) RC(0,2) RC(0,3) RC(0,4) 
            RC(1,0)   RC(1,1) RC(1,2) RC(1,3) RC(1,4) 
            RC(2,0)     RC(2,1) RC(2,2) RC(2,3) RC(2,4)
            RC(3,0)       RC(3,1) RC(3,2) RC(3,3) RC(3,4) 
            RC(4,0)   RC(4,1)   RC(4,2)                      RC(4,3)                     RC(4,4)  
    };


    kscan0: kscan_0 {
        compatible = "zmk,kscan-gpio-matrix";
        wakeup-source;

        diode-direction = "col2row";

        col-gpios
            = <&gpio0 17 GPIO_ACTIVE_HIGH>
            , <&gpio0 20 GPIO_ACTIVE_HIGH>
            , <&gpio0 22 GPIO_ACTIVE_HIGH>
            , <&gpio0 24 GPIO_ACTIVE_HIGH>
            , <&gpio1 0 GPIO_ACTIVE_HIGH>
            ;

        row-gpios
            = <&gpio1 13 (GPIO_ACTIVE_HIGH | GPIO_PULL_DOWN)>
            , <&gpio1 11 (GPIO_ACTIVE_HIGH | GPIO_PULL_DOWN)>
            , <&gpio0 10 (GPIO_ACTIVE_HIGH | GPIO_PULL_DOWN)>
            , <&gpio0 09 (GPIO_ACTIVE_HIGH | GPIO_PULL_DOWN)>
            , <&gpio1 06 (GPIO_ACTIVE_HIGH | GPIO_PULL_DOWN)>
            ;
    };
};

&layout_60_ansi {
    transform = <&default_transform>;
};
